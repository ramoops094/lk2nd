/dts-v1/;

/include/ "msm8953.dtsi"
/include/ "motorola-carrier-channel-ids.dtsi"

/ {
	#address-cells = <2>;
	#size-cells = <2>;
	qcom,msm-id = <0x125 0x00>;
	qcom,board-id = <0x47 0xb1a0>,
			<0x47 0xb1b0>,
			<0x47 0xb200>,
			<0x47 0xa200>,
			<0x4d 0xc100>,
			<0x4d 0xc200>;

	model = "deen";
	compatible = "motorola,deen", "qcom,msm8953", "lk2nd,device";
	lk2nd,pstore = <0xef000000 0xc0000>;

	lk2nd,motorola-unitinfo = <1>;

	panel {
		compatible = "motorola,deen-panel";

		qcom,mdss_dsi_mot_tianma_586_720p_vid_v0 {
			compatible = "motorola,deen-tianma-586";
		};

		qcom,mdss_dsi_mot_nova_586_hd_vid_v0 {
			compatible = "motorola,deen-nova-586";
		};
	};
};
